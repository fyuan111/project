## Kconfig
```kconfig
# FML Kconfig configuration

# 首先包含 Zephyr 的主配置
source "Kconfig.zephyr"

menuconfig FML
    bool "FML Configuration"
    default y
    help
      Flight Module Library configuration options.

if FML

# 自动包含所有库的 Kconfig
rsource "src/lib/*/Kconfig"

# 自动包含所有应用的 Kconfig（可选，如果不存在不会报错）
# rsource "src/Applications/*/Kconfig"

endif # FML
```

## boards/esp32s3_devkitm_procpu.conf
```kconfig
# ESP32-S3 板级配置
# 高精度时钟设置 (ESP32 支持)
CONFIG_SYS_CLOCK_TICKS_PER_SEC=1000
CONFIG_TIMER_READS_ITS_FREQUENCY_AT_RUNTIME=y
```

## src/lib/perf/Kconfig
```kconfig
config FML_PERF
    bool "Performance measurement library"
    default y
    help
      Enable performance measurement and timing tools.

if FML_PERF

config FML_PERF_PRINT
    bool "Print performance measurements"
    default y
    help
      Print timing information to console.

endif # FML_PERF
```

## test/workqueue_latency/testcase.yaml
```yaml
tests:
  fml.workqueue.latency:
    tags: performance
    type: unit
    harness: ztest
    integration_platforms:
      - native_posix
      - qemu_cortex_m3
    platform_allow:
      - native_posix
      - qemu_cortex_m3
      # 添加你的实际硬件平台
    timeout: 30
```
